## release/src-rt-6.x.4708/router/config/config.in
```kconfig
mainmenu "FreshTomato Configuration"

config TCONFIG_OPTIMIZE_SHARED_LIBS
	bool "Optimize shared libraries (remove unused symbols)"
	default y

config TCONFIG_L2TP
	bool "L2TP"
	default y

config TCONFIG_PPTP
	bool "PPTP"
	default y

config TCONFIG_PPTPD
	bool "PPTPD"
	depends on TCONFIG_PPTP
	default n

config TCONFIG_MULTIWAN
	bool "MultiWAN support"
	default n

config TCONFIG_HTTPS
	bool "HTTPS"
	default y

config TCONFIG_SSH
	bool "SSH"
	default y

config TCONFIG_CIFS
	bool "CIFS Client"
	default y

config TCONFIG_BRCM_NAND_JFFS2
	bool "JFFS Support on BRCM Nand Flash Partition"
	default n

config TCONFIG_JFFS2
	bool "JFFS Support"
	default y

config TCONFIG_JFFSV1
	bool "  Use JFFSv1 (if not selected, JFFS2 is used)"
	depends on TCONFIG_JFFS2
	default y

config TCONFIG_DDNS
	bool "Dynamic DNS"
	default y

config TCONFIG_L7
	bool "Layer 7 Netfilter"
	default y

config TCONFIG_L7PAT
	bool "  Standard Layer 7 Patterns"
	depends on TCONFIG_L7
	default y

config TCONFIG_LZO
	bool "LZO Compression"
	default n

config TCONFIG_OPENVPN
	bool "OpenVPN"
	depends on TCONFIG_LZO
	default n

config TCONFIG_WIREGUARD
	bool "WireGuard"
	default n

# !!TB
config TCONFIG_IPV6
	bool "IPv6 Support"
	default n

config TCONFIG_EBTABLES
	bool "Ebtables"
	default n

config TCONFIG_EMF
	bool "Broadcom EMF (Efficient Multicast Forwarding & IGMP Snooping)"
	default n

config TCONFIG_USB
	bool "USB Support"
	default y

config TCONFIG_NOCAT
	bool "NoCat Splash"
	default n

config TCONFIG_NGINX
	bool "NGinX Web Server"
	default n

config TCONFIG_MEDIA_SERVER
	bool "Media Server (MiniDLNA)"
	depends on TCONFIG_USB
	default n

config TCONFIG_FTP
	bool "  FTP Server"
	depends on TCONFIG_USB
	default y

config TCONFIG_FTP_SSL
	bool "    FTP SSL Support"
	depends on TCONFIG_FTP
	default n

config TCONFIG_SAMBASRV
	bool "  Samba File Sharing"
	depends on TCONFIG_USB
	default y

config TCONFIG_USB_EXTRAS
	bool "  Additional modules and utilities"
	depends on TCONFIG_USB
	default n

config TCONFIG_NTFS
	bool "  NTFS-3g Support"
	depends on TCONFIG_USB
	default n

config TCONFIG_BT
	bool "  Bittorrent client gui only"
	default n

config TCONFIG_BBT
	bool "  Bittorrent client binaries only"
	default n

config TCONFIG_TR_EXTRAS
	bool "  Transmission extra tools"
	default n
	depends on TCONFIG_BT

config TCONFIG_NFS
	bool "  NFS Server"
	default n

config TCONFIG_SNMP
	bool "  SNMP"
	default n

config TCONFIG_HFS
	bool "  HFS/HFS+ filesystem support "
	default n

config TCONFIG_UPS
	bool "  UPS Monitor"
	depends on TCONFIG_USB
	default n

config TCONFIG_NANO
	bool "  NANO - user-friendly file editor"
	default n

config TCONFIG_DNSCRYPT
	bool "  DNScrypt-proxy"
	default n

config TCONFIG_STUBBY
	bool "  Stubby - DNS-over-TLS resolver"
	depends on TCONFIG_DNSSEC
	default n

config TCONFIG_NVRAM_64K
	bool "NVRAM_64K"
	default n

config TCONFIG_NVRAM_128K
	bool "NVRAM_128K"
	default n

config TCONFIG_TOR
	bool "  TOR Project"
	default n

config TCONFIG_IPSEC
	bool "IPSec Support"
	default n

config TCONFIG_RAID
	bool "RAID Support: mdadm plus md modules"
	default n

config TCONFIG_USBAP
	bool "Include wl_high module"
	depends on TCONFIG_USB
	default n

config TCONFIG_REMOVE_USBAPP
	bool "Remove USB Application (samba/ftp/usb support page)"
	depends on TCONFIG_USBAP
	default n

config TCONFIG_CTF
	bool "CTF (Cut-Through Forwarding)"
	default n

config TCONFIG_NAND
	bool "NAND flash support"
	default n

config TCONFIG_UFSDA
	bool "Paragon NTFS driver for Asus routers"
	default n

config TCONFIG_TUXERA
	bool "Tuxera NTFS driver for Asus routers"
	default n

config TCONFIG_TUXERA_HFS
	bool "Tuxera HFS/HFS+ driver for Asus routers"
	default n

config TCONFIG_BCMARM
	bool "Bcm Arm"
	default n

config TCONFIG_BCMWL6
	bool "BCM WL 6"
	default n

config TCONFIG_BCMWL6A
	bool "BCM WL 6.30.143"
	depends on TCONFIG_BCMARM && TCONFIG_BCMWL6
	default n

config TCONFIG_BCMSMP
	bool "BCM SMP"
	default n

config TCONFIG_PROXYSTA
	bool "Proxy STA"
	default n

config TCONFIG_DPSTA
	bool "Bcm7 dpsta"
	default n

config TCONFIG_GROCTRL
	bool "GRO Control"
	default n

config TCONFIG_BCMFA
	bool "BCM FA"
	default n

config TCONFIG_BCMBSD
	bool "Brcm Band Steer Selection"
	default n

config TCONFIG_DNSSEC
	bool "DNSSEC"
	default n

config TCONFIG_TINC
	bool "TINC"
	default n

config TCONFIG_OPENSSL11
	bool "OpenSSL 1.1.x"
	default n

config TCONFIG_FANCTRL
	bool "FANCTRL"
 	default n

config TCONFIG_IPERF
	bool "IP Bandwidth monitoring utility"
	default n

config TCONFIG_KEYGEN
	bool "TLS keys generator in GUI for VPN Server"
	default y

config TCONFIG_TERMLIB
	bool "Termlib based tools-shell.asp"
	default y

config TCONFIG_ADVTHEMES
	bool "Advanced Themes similar to AdvancedTomato"
	default y

config TCONFIG_NVRAM_32K
	bool "NVRAM_32K"
	default n

config TCONFIG_CONNTRACK_TOOL
	bool "Conntrack Userspace Tool"
	default n
```
